## bridgeos/Config.in
```kconfig
menu "Radxa ZERO 3W appliance"
source "$BR2_EXTERNAL_RADXA_ZERO3_RT_PATH/package/bridge-daemon/Config.in"
source "$BR2_EXTERNAL_RADXA_ZERO3_RT_PATH/package/osumania-optee-ta/Config.in"
source "$BR2_EXTERNAL_RADXA_ZERO3_RT_PATH/package/osumania-optee-test/Config.in"
endmenu
```

## bridgeos/configs/radxa_zero3_optee_debug_defconfig
```kconfig
BR2_aarch64=y
BR2_cortex_a55=y
BR2_TOOLCHAIN_BUILDROOT_GLIBC=y
BR2_GCC_VERSION_14_X=y
BR2_PACKAGE_HOST_LINUX_HEADERS_CUSTOM_6_18=y
BR2_REPRODUCIBLE=y
BR2_TARGET_GENERIC_HOSTNAME="zero3-optee-debug"
BR2_TARGET_GENERIC_ISSUE="Radxa ZERO 3W OP-TEE debug"
BR2_TARGET_GENERIC_GETTY=y
BR2_TARGET_GENERIC_GETTY_PORT="ttyS2"
BR2_TARGET_GENERIC_GETTY_BAUDRATE_KEEP=y
BR2_ROOTFS_OVERLAY="$(BR2_EXTERNAL_RADXA_ZERO3_RT_PATH)/board/radxa-zero3-rt/rootfs-overlay $(BR2_EXTERNAL_RADXA_ZERO3_RT_PATH)/board/radxa-zero3-rt/debug-overlay"
BR2_ROOTFS_POST_BUILD_SCRIPT="$(BR2_EXTERNAL_RADXA_ZERO3_RT_PATH)/board/radxa-zero3-rt/post-build.sh"
BR2_ROOTFS_POST_IMAGE_SCRIPT="$(BR2_EXTERNAL_RADXA_ZERO3_RT_PATH)/board/radxa-zero3-rt/post-image.sh"
BR2_ROOTFS_POST_SCRIPT_ARGS="optee-debug"
BR2_LINUX_KERNEL=y
BR2_LINUX_KERNEL_CUSTOM_GIT=y
BR2_LINUX_KERNEL_CUSTOM_REPO_URL="https://github.com/radxa/kernel.git"
BR2_LINUX_KERNEL_CUSTOM_REPO_VERSION="559f4f921a01e5358602153364c618fe2a3e431e"
BR2_LINUX_KERNEL_USE_ARCH_DEFAULT_CONFIG=y
BR2_LINUX_KERNEL_CONFIG_FRAGMENT_FILES="$(BR2_EXTERNAL_RADXA_ZERO3_RT_PATH)/board/radxa-zero3-rt/kernel.fragment $(BR2_EXTERNAL_RADXA_ZERO3_RT_PATH)/board/radxa-zero3-rt/kernel-debug.fragment"
BR2_LINUX_KERNEL_IMAGE=y
BR2_LINUX_KERNEL_DTS_SUPPORT=y
BR2_LINUX_KERNEL_CUSTOM_DTS_DIR="$(BR2_EXTERNAL_RADXA_ZERO3_RT_PATH)/board/radxa-zero3-rt/dts"
BR2_LINUX_KERNEL_NEEDS_HOST_OPENSSL=y
BR2_TARGET_ROOTFS_CPIO=y
BR2_TARGET_ROOTFS_CPIO_GZIP=y
BR2_PACKAGE_BRIDGE_DAEMON=y
BR2_PACKAGE_BRIDGE_DAEMON_DEV_CRYPTO=y
BR2_PACKAGE_OSUMANIA_OPTEE_TEST=y
BR2_PACKAGE_RT_TESTS=y
BR2_PACKAGE_TRACE_CMD=y
BR2_PACKAGE_STRESS_NG=y
BR2_PACKAGE_HOST_GENIMAGE=y
BR2_PACKAGE_HOST_E2FSPROGS=y
BR2_PACKAGE_HOST_DTC=y
BR2_PACKAGE_HOST_DOSFSTOOLS=y
BR2_PACKAGE_HOST_MTOOLS=y
```

## bridgeos/configs/radxa_zero3_optee_runtime_defconfig
```kconfig
BR2_aarch64=y
BR2_cortex_a55=y
BR2_TOOLCHAIN_BUILDROOT_GLIBC=y
BR2_GCC_VERSION_14_X=y
BR2_PACKAGE_HOST_LINUX_HEADERS_CUSTOM_6_18=y
BR2_REPRODUCIBLE=y
BR2_TARGET_GENERIC_HOSTNAME="zero3-optee-rt"
BR2_TARGET_GENERIC_ISSUE="Radxa ZERO 3W source OP-TEE RT appliance"
# BR2_TARGET_GENERIC_GETTY is not set
# BR2_TARGET_GENERIC_REMOUNT_ROOTFS_RW is not set
BR2_PACKAGE_BUSYBOX_CONFIG_FRAGMENT_FILES="$(BR2_EXTERNAL_RADXA_ZERO3_RT_PATH)/board/radxa-zero3-rt/busybox.fragment"
# BR2_PACKAGE_BUSYBOX_SHOW_OTHERS is not set
# BR2_PACKAGE_IFUPDOWN_SCRIPTS is not set
BR2_ROOTFS_OVERLAY="$(BR2_EXTERNAL_RADXA_ZERO3_RT_PATH)/board/radxa-zero3-rt/rootfs-overlay"
BR2_ROOTFS_POST_BUILD_SCRIPT="$(BR2_EXTERNAL_RADXA_ZERO3_RT_PATH)/board/radxa-zero3-rt/post-build.sh"
BR2_ROOTFS_POST_IMAGE_SCRIPT="$(BR2_EXTERNAL_RADXA_ZERO3_RT_PATH)/board/radxa-zero3-rt/post-image.sh"
BR2_ROOTFS_POST_SCRIPT_ARGS="optee-runtime"
BR2_LINUX_KERNEL=y
BR2_LINUX_KERNEL_CUSTOM_GIT=y
BR2_LINUX_KERNEL_CUSTOM_REPO_URL="https://github.com/radxa/kernel.git"
BR2_LINUX_KERNEL_CUSTOM_REPO_VERSION="559f4f921a01e5358602153364c618fe2a3e431e"
BR2_LINUX_KERNEL_USE_ARCH_DEFAULT_CONFIG=y
BR2_LINUX_KERNEL_CONFIG_FRAGMENT_FILES="$(BR2_EXTERNAL_RADXA_ZERO3_RT_PATH)/board/radxa-zero3-rt/kernel.fragment"
BR2_LINUX_KERNEL_IMAGE=y
BR2_LINUX_KERNEL_DTS_SUPPORT=y
BR2_LINUX_KERNEL_CUSTOM_DTS_DIR="$(BR2_EXTERNAL_RADXA_ZERO3_RT_PATH)/board/radxa-zero3-rt/dts"
BR2_LINUX_KERNEL_NEEDS_HOST_OPENSSL=y
BR2_TARGET_ROOTFS_CPIO=y
BR2_TARGET_ROOTFS_CPIO_GZIP=y
BR2_PACKAGE_BRIDGE_DAEMON=y
BR2_PACKAGE_BRIDGE_DAEMON_DEV_CRYPTO=y
BR2_PACKAGE_HOST_GENIMAGE=y
BR2_PACKAGE_HOST_E2FSPROGS=y
BR2_PACKAGE_HOST_DTC=y
```

## bridgeos/package/bridge-daemon/Config.in
```kconfig
config BR2_PACKAGE_BRIDGE_DAEMON
	bool "bridge-daemon"
	depends on BR2_LINUX_KERNEL
	select BR2_PACKAGE_OPENSSL
	select BR2_PACKAGE_LIBOPENSSL
	select BR2_PACKAGE_OPTEE_CLIENT
	help
	  PREEMPT_RT keyboard forwarding plus canonical osu!mania Vendor HID v1.
	  The production signer backend uses the stateful OP-TEE Client API and
	  fails closed when BL32 or the TA is unavailable.

if BR2_PACKAGE_BRIDGE_DAEMON

config BR2_PACKAGE_BRIDGE_DAEMON_DEV_CRYPTO
	bool "insecure development SRS and signer backend"
	help
	  Install the public 260-point development SRS. This supports at most
	  65 events and must never be presented as production hardware security.

endif
```

## bridgeos/package/osumania-optee-ta/Config.in
```kconfig
config BR2_PACKAGE_OSUMANIA_OPTEE_TA
	bool "osu!mania OP-TEE constrained signer TA"
	depends on BR2_TARGET_OPTEE_OS
	select BR2_TARGET_OPTEE_OS_SDK
	help
	  Build the stateful signer TA. The RK3566 hardware-root backend fails
	  closed until a reviewed Secure OTP/HUK platform hook is supplied.

if BR2_PACKAGE_OSUMANIA_OPTEE_TA

config BR2_PACKAGE_OSUMANIA_OPTEE_TA_DEV_KEY
	bool "DEV_INSECURE_KEY_BACKEND"
	help
	  Development only. Uses a public deterministic root and emits a warning.

endif
```

## bridgeos/package/osumania-optee-test/Config.in
```kconfig
config BR2_PACKAGE_OSUMANIA_OPTEE_TEST
	bool "osu!mania OP-TEE integration test"
	select BR2_PACKAGE_OPTEE_CLIENT
	select BR2_PACKAGE_OPENSSL
	select BR2_PACKAGE_LIBOPENSSL
	help
	  Executes the constrained TA state machine and verifies Ethereum recovery.
```
